## TemperatureSensorNRF52833/build_nrf52833dk_nrf52833/Kconfig/Kconfig.shield
```kconfig
osource "C:/nRF/v1.5.1/nrf/boards/shields/*/Kconfig.shield"
osource "C:/nRF/v1.5.1/zephyr/boards/shields/*/Kconfig.shield"
osource "C:/nRF/v1.5.1/zephyr/boards/shields/*/Kconfig.shield"
```

## TemperatureSensorNRF52833/build_nrf52833dk_nrf52833/Kconfig/Kconfig.shield.defconfig
```kconfig
osource "C:/nRF/v1.5.1/nrf/boards/shields/*/Kconfig.defconfig"
osource "C:/nRF/v1.5.1/zephyr/boards/shields/*/Kconfig.defconfig"
osource "C:/nRF/v1.5.1/zephyr/boards/shields/*/Kconfig.defconfig"
```

## TemperatureSensorNRF52833/build_nrf52833dk_nrf52833/Kconfig/Kconfig.soc.arch
```kconfig
osource "C:/nRF/v1.5.1/zephyr/soc/$(ARCH)/Kconfig"
osource "C:/nRF/v1.5.1/zephyr/soc/$(ARCH)/*/Kconfig"
```
